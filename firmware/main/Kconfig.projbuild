## firmware/main/Kconfig.projbuild
```kconfig
menu "CARBENTRA development endpoint"
config CARBENTRA_ALLOW_ACTUATION
    bool "Enable relay requests after independent hardware release"
    default n
    help
        Must remain disabled until complete mains design, calibration and physical
        safety review. Compilation is not authorization to energize any load.
config CARBENTRA_BOARD_REV_B
    bool "Use revision B GPIO3 output-presence feedback"
    default y
endmenu
```

## firmware/sdkconfig.defaults
```kconfig
CONFIG_IDF_TARGET="esp32c3"
CONFIG_ESPTOOLPY_FLASHSIZE_4MB=y
CONFIG_PARTITION_TABLE_CUSTOM=y
CONFIG_PARTITION_TABLE_CUSTOM_FILENAME="partitions.csv"
CONFIG_BT_ENABLED=y
CONFIG_BT_NIMBLE_ENABLED=y
CONFIG_BT_BLUEDROID_ENABLED=n
CONFIG_ESP_MAIN_TASK_STACK_SIZE=8192
CONFIG_ESP_WIFI_SOFTAP_SUPPORT=n
CONFIG_ESP_PROTOCOMM_SUPPORT_SECURITY_VERSION_2=y
CONFIG_CM_ALLOW_ACTUATION=n
```
